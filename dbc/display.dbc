VERSION ""

NS_ :

BS_:

BU_:

BO_ 2147487809 neopixel_left: 64 Vector__XXX
 SG_ brightness : 7|8@0+ (1,0) [0|0] "" Vector__XXX
 SG_ led_left_0 : 15|24@0+ (1,0) [0|0] "" Vector__XXX
 SG_ led_left_1 : 39|24@0+ (1,0) [0|0] "" Vector__XXX
 SG_ led_left_2 : 63|24@0+ (1,0) [0|0] "" Vector__XXX

BO_ 2147487810 neopixel_right: 64 Vector__XXX
 SG_ brightness : 7|8@0+ (1,0) [0|0] "" Vector__XXX
 SG_ led_right_1 : 39|24@0+ (1,0) [0|0] "" Vector__XXX
 SG_ led_right_2 : 63|24@0+ (1,0) [0|0] "" Vector__XXX
 SG_ led_right_0 : 15|24@0+ (1,0) [0|0] "" Vector__XXX

BO_ 2147487808 neopixel: 64 Vector__XXX
 SG_ led_00 : 15|24@0+ (1,0) [0|0] "" Vector__XXX
 SG_ led_01 : 39|24@0+ (1,0) [0|0] "" Vector__XXX
 SG_ led_02 : 63|24@0+ (1,0) [0|0] "" Vector__XXX
 SG_ led_03 : 87|24@0+ (1,0) [0|0] "" Vector__XXX
 SG_ led_04 : 111|24@0+ (1,0) [0|0] "" Vector__XXX
 SG_ led_05 : 135|24@0+ (1,0) [0|0] "" Vector__XXX
 SG_ led_06 : 159|24@0+ (1,0) [0|0] "" Vector__XXX
 SG_ led_07 : 183|24@0+ (1,0) [0|0] "" Vector__XXX
 SG_ led_08 : 207|24@0+ (1,0) [0|0] "" Vector__XXX
 SG_ led_09 : 231|24@0+ (1,0) [0|0] "" Vector__XXX
 SG_ led_10 : 255|24@0+ (1,0) [0|0] "" Vector__XXX
 SG_ led_11 : 279|24@0+ (1,0) [0|0] "" Vector__XXX
 SG_ led_12 : 303|24@0+ (1,0) [0|0] "" Vector__XXX
 SG_ led_13 : 327|24@0+ (1,0) [0|0] "" Vector__XXX
 SG_ led_14 : 351|24@0+ (1,0) [0|0] "" Vector__XXX
 SG_ brightness : 7|8@0+ (1,0) [0|0] "" Vector__XXX

BA_DEF_ BO_  "VFrameFormat" ENUM  "StandardCAN","ExtendedCAN","reserved","reserved","reserved","reserved","reserved","reserved","reserved","reserved","reserved","reserved","reserved","reserved","StandardCAN_FD","ExtendedCAN_FD";
BA_DEF_  "BusType" STRING ;
BA_DEF_DEF_  "VFrameFormat" "ExtendedCAN_FD";
BA_DEF_DEF_  "BusType" "CAN";
BA_ "BusType" "CAN FD";
